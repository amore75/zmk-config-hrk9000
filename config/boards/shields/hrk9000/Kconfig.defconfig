## config/boards/shields/hrk9000/Kconfig.defconfig
```kconfig
# Copyright (c) 2020 The ZMK Contributors
# SPDX-License-Identifier: MIT

if SHIELD_hrk9000_LEFT

config ZMK_KEYBOARD_NAME
    default "BFO-9000"

config ZMK_SPLIT_ROLE_CENTRAL
    default y

endif

if SHIELD_hrk9000_LEFT || SHIELD_hrk9000_RIGHT

config ZMK_SPLIT
    default y

endif
```

## config/boards/shields/hrk9000/Kconfig.shield
```kconfig
# Copyright (c) 2020 The ZMK Contributors
# SPDX-License-Identifier: MIT

config SHIELD_hrk9000_LEFT
    def_bool $(shields_list_contains,hrk9000_left)

config SHIELD_hrk9000_RIGHT
    def_bool $(shields_list_contains,hrk9000_right)
```
